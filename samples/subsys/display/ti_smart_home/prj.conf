## CMakeLists.txt
```
# SPDX-License-Identifier: Apache-2.0

cmake_minimum_required(VERSION 3.20.0)

find_package(Zephyr REQUIRED HINTS $ENV{ZEPHYR_BASE})
project(ti_washing_machine)

set(UI_DIR ${CMAKE_CURRENT_SOURCE_DIR}/ui)

# Generated UI source list + hand-written custom sources. Both files append to
# LV_EDITOR_PROJECT_SOURCES using ${CMAKE_CURRENT_LIST_DIR}, which resolves to
# ui/ when included from here.
include(${UI_DIR}/file_list_gen.cmake)
include(${UI_DIR}/user_config.cmake)

target_sources(app PRIVATE
	src/main.c
	${LV_EDITOR_PROJECT_SOURCES}
)

# The UI uses both same-directory ("washing_machine_gen.h") and root-relative
# ("components/base/card/card_gen.h") includes, so the ui/ root is enough.
target_include_directories(app PRIVATE ${UI_DIR})

# Zephyr's LVGL module adds ${LVGL_DIR}/src/ to the include path (where both
# lvgl.h and lvgl_private.h live), but does NOT add ${LVGL_DIR}/ itself.
# The vendored UI headers include either "lvgl.h" or "lvgl/lvgl.h" depending
# on this guard — setting it picks the flat form that matches what's reachable.
target_compile_definitions(app PRIVATE LV_LVGL_H_INCLUDE_SIMPLE)
```

## prj.conf
```kconfig
# Base LVGL/display tuning carried over unchanged from
# zephyr/samples/modules/lvgl/demos/prj.conf, already proven working on this
# board with the lv_demo_music sample.
CONFIG_MAIN_STACK_SIZE=35480
CONFIG_LOG=y
CONFIG_SHELL=y

CONFIG_LVGL=y
CONFIG_LV_Z_MEM_POOL_SIZE=8097152
CONFIG_LV_Z_SHELL=y
CONFIG_LV_Z_BUFFER_ALLOC_STATIC=y
CONFIG_FAST_OPTIMIZATIONS=y
CONFIG_LV_Z_DOUBLE_VDB=y
CONFIG_LV_Z_FLUSH_THREAD=y
CONFIG_LV_Z_RUN_LVGL_ON_WORKQUEUE=y
CONFIG_LV_COLOR_DEPTH_32=y
CONFIG_LV_Z_VDB_SIZE=100
CONFIG_LV_Z_FULL_REFRESH=y
CONFIG_LV_DRAW_LAYER_SIMPLE_BUF_SIZE=1486432
CONFIG_MIPI_DSI=y
# CONFIG_LV_LOG_LEVEL_WARN=y
# CONFIG_LV_LOG_LEVEL_TRACE=y

CONFIG_DISPLAY=y
CONFIG_INPUT=y

CONFIG_I2C=y
CONFIG_I2C_TARGET=y
CONFIG_I2C_SHELL=y

CONFIG_LOG_PROCESS_THREAD_STACK_SIZE=4096
CONFIG_LV_Z_FLUSH_THREAD_STACK_SIZE=35480
CONFIG_LV_Z_LVGL_WORKQUEUE_STACK_SIZE=35480
CONFIG_INPUT_QUEUE_MAX_MSGS=50

# Widgets and features used by the ti-smart-home UI (see components/ and
# ti_smart_home.c: arc thermostat, EV charge bar/chart, buttons, checkboxes,
# images, labels, sliders, switches, subject/observer data binding, and
# lv_obj_find_by_name lookups in the contact/music callbacks).
CONFIG_LV_USE_ARC=y
CONFIG_LV_USE_BAR=y
CONFIG_LV_USE_BUTTON=y
CONFIG_LV_USE_CHART=y
CONFIG_LV_USE_CHECKBOX=y
CONFIG_LV_USE_IMAGE=y
CONFIG_LV_USE_LABEL=y
CONFIG_LV_USE_SLIDER=y
CONFIG_LV_USE_SWITCH=y
CONFIG_LV_USE_OBSERVER=y
# Float-type subjects, used by custom/thermostat_logic.c's lv_subject_get_float
# calls for the derived climate state (auto-mode changeover). Not implied by
# LV_USE_OBSERVER - each subject type (bool/int/float/color/...) is separate.
CONFIG_LV_USE_FLOAT=y
CONFIG_LV_USE_OBJ_NAME=y
# CONFIG_INPUT_EVENT_DUMP=y
# CONFIG_DISPLAY_LOG_LEVEL_DBG=y
CONFIG_INPUT_GT911_MAX_TOUCH_POINTS=1
```

## src/main.c
```c
/*
 * SPDX-License-Identifier: Apache-2.0
 */

#include <zephyr/kernel.h>
#include <zephyr/drivers/display.h>
#include <lvgl.h>
#include <lvgl_zephyr.h>
#include <ti_smart_home.h>

#define LOG_LEVEL CONFIG_LOG_DEFAULT_LEVEL
#include <zephyr/logging/log.h>
LOG_MODULE_REGISTER(app);

int main(void)
{
	const struct device *display_dev;
	int ret;

	display_dev = DEVICE_DT_GET(DT_CHOSEN(zephyr_display));	
	if (!device_is_ready(display_dev)) {
		LOG_ERR("Display device not ready, aborting");
		return 0;
	}

	lvgl_lock();
	// lv_display_get_default();
	// lv_display_set_rotation(lv_display_get_default(), LV_DISPLAY_ROTATION_90);
	/*
	 * Render draw tasks directly into the panel's native-shaped buffer via a
	 * per-task coordinate matrix, instead of rendering into a logical-shaped
	 * buffer and rotating the whole buffer in the flush callback afterward.
	 */
	// lv_display_set_matrix_rotation(lv_display_get_default(), true);
	ti_smart_home_init(NULL);
	// thermostat_init(NULL);
	// motor_control_init(NULL);
	// washing_machine_init(NULL);
#ifndef CONFIG_LV_Z_RUN_LVGL_ON_WORKQUEUE
	lv_timer_handler();
#endif
	lvgl_unlock();

	ret = display_blanking_off(display_dev);
	if (ret < 0 && ret != -ENOSYS) {
		LOG_ERR("Failed to turn blanking off (error %d)", ret);
		return 0;
	}

	while (1) {
#ifndef CONFIG_LV_Z_RUN_LVGL_ON_WORKQUEUE
		uint32_t sleep_ms;

		lvgl_lock();
		sleep_ms = lv_timer_handler();
		lvgl_unlock();

		k_msleep(MIN(sleep_ms, INT32_MAX));
#else
		/* LVGL is serviced by its dedicated workqueue; just idle here. */
		k_msleep(10);
#endif
	}

	return 0;
}
```
