## boards/ti/am62l_evm/am62l_evm_am62l3_a53_defconfig
```kconfig
# Texas Instruments Sitara AM62L EVM
#
# Copyright (c) 2025 Texas Instruments Incorporated
#
# SPDX-License-Identifier: Apache-2.0

# Zephyr Kernel Configuration
CONFIG_XIP=n

# Serial Driver
CONFIG_SERIAL=y

# Enable Console
CONFIG_CONSOLE=y
CONFIG_UART_CONSOLE=y
CONFIG_UART_INTERRUPT_DRIVEN=y

# ARM Options
CONFIG_AARCH64_IMAGE_HEADER=y
CONFIG_ARMV8_A_NS=y
CONFIG_ARM64_VA_BITS_36=y
CONFIG_ARM64_PA_BITS_36=y
CONFIG_ARM_SCMI=y

# Cache Options
CONFIG_CACHE_MANAGEMENT=y
CONFIG_DCACHE_LINE_SIZE_DETECT=y
CONFIG_ICACHE_LINE_SIZE_DETECT=y

# Multicore Support
CONFIG_SMP=y
# CONFIG_SCHED_THREAD_USAGE=y
# CONFIG_SCHED_THREAD_USAGE_ALL=y
CONFIG_PM_CPU_OPS=y
CONFIG_MP_MAX_NUM_CPUS=2
# CONFIG_SCHED_CPU_MASK=y
# CONFIG_CPU_LOAD=y
# CONFIG_CPU_LOAD_USE_COUNTER=y
# CONFIG_WAIT_AT_RESET_VECTOR=y

# Clock Control
CONFIG_CLOCK_CONTROL=y

# Power Domain
CONFIG_PM_DEVICE=y
CONFIG_POWER_DOMAIN=y

# TF-A Build Configuration
CONFIG_BUILD_WITH_TFA=y
CONFIG_TFA_PLATFORM="k3low"
CONFIG_TFA_ARTIFACT_SUBDIR=y
CONFIG_TI_K3_BUILD_TISPL=y
CONFIG_TI_K3_BUILD_TIBOOT3=y
# CONFIG_DISPLAY=y
# CONFIG_TI_DSS=y
# CONFIG_MIPI_DSI=y
# CONFIG_TC358762=y
# CONFIG_MIPI_DSI_CDNS_TI=y

# GPIO — required for RPi panel MCU (reset-gpios) and TCA6424A expander
CONFIG_GPIO=y
CONFIG_I2C=y

# Input — GT911 capacitive touch on RPi Touch Display 2
CONFIG_INPUT=y
CONFIG_DISPLAY_INIT_PRIORITY=91
# CONFIG_FILE_SYSTEM=y
# CONFIG_FILE_SYSTEM_EXT2=n
# CONFIG_FILE_SYSTEM_LIB_LINK=y
# CONFIG_DISK_ACCESS=y
# CONFIG_INIT_STACKS=n
# CONFIG_UART_CONSOLE=n
# CONFIG_FILE_SYSTEM_SHELL=y
# CONFIG_FILE_SYSTEM_MKFS=y
# CONFIG_FAT_FILESYSTEM_ELM=y
# # CONFIG_FILE_SYSTEM_SHELL_MOUNT_COMMAND=y
# CONFIG_HEAP_MEM_POOL_SIZE=1677
# # CONFIG_FS_LOG_LEVEL_INF=y
# CONFIG_SHELL_STACK_SIZE=4096
# CONFIG_FS_FATFS_MKFS=y

# Virtual address space: kernel image + MMIO mappings + 16 MB framebuffers
# CONFIG_KERNEL_VM_SIZE=0x80000000
# CONFIG_HEAP_MEM_POOL_SIZE=16777216
# CONFIG_KERNEL_VM_SIZE=0x7FE00000
```

## drivers/display/Kconfig.ili9881c_dsi
```kconfig
# Copyright (c) 2024
# SPDX-License-Identifier: Apache-2.0

config ILI9881C_DSI
	bool "ILI9881C-based MIPI-DSI panel drivers"
	default y
	depends on DT_HAS_BANANAPI_LHR050H41_ENABLED || \
		   DT_HAS_FEIXIN_K101_IM2BYL02_ENABLED || \
		   DT_HAS_STARTEK_KD050HDFIA020_ENABLED || \
		   DT_HAS_TDO_TL050HDV35_ENABLED || \
		   DT_HAS_WANCHANGLONG_W552946ABA_ENABLED || \
		   DT_HAS_AMPIRE_AM8001280G_ENABLED || \
		   DT_HAS_RASPBERRYPI_DSI_5INCH_ENABLED || \
		   DT_HAS_RASPBERRYPI_DSI_7INCH_ENABLED
	select MIPI_DSI
	help
	  Enable the ILI9881C-family MIPI-DSI panel driver, supporting the
	  BananaPi LHR050H41, Feixin K101-IM2BYL02, Startek KD050HDFIA020,
	  TDO TL050HDV35, WanChangLong W552946ABA, Ampire AM8001280G, and
	  the Raspberry Pi 5-inch/7-inch DSI touch displays.

if ILI9881C_DSI

config ILI9881C_DSI_INIT_PRIORITY
	int "Initialization priority"
	default 90
	help
	  ILI9881C_DSI display driver initialization priority.

endif
```

## dts/bindings/display/raspberrypi,dsi-7inch.yaml
```yaml
# Copyright (c) 2026 Texas Instruments Incorporated
# SPDX-License-Identifier: Apache-2.0

title: Raspberry Pi Touch Display 2 (7-inch) DSI panel

description: |
  Raspberry Pi Touch Display 2, 7-inch variant. An ILI9881C-based MIPI DSI
  panel, driven in video mode.

compatible: "raspberrypi,dsi-7inch"

include: [mipi-dsi-device.yaml, display-controller.yaml]

properties:
  reset-gpios:
    type: phandle-array
    description: |
      Panel reset line (active-low), per the upstream
      vc4-kms-dsi-ili9881-7inch-overlay.dts.

  bl-gpios:
    type: phandle-array
    description: |
      Optional backlight enable line, if not controlled through the
      panel-regulator MCU instead.
```
